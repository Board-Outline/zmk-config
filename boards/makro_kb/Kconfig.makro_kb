## boards/makro_kb/Kconfig.makro_kb
```kconfig
config BOARD_MAKRO_KB
    select SOC_NRF52840_QIAA
    imply RETAINED_MEM
    imply RETENTION
    imply RETENTION_BOOT_MODE
    select ZMK_BOARD_COMPAT
```

## boards/ortho_test/Kconfig.ortho_test
```kconfig
config BOARD_ORTHO_TEST
    select SOC_NRF52840_QIAA
    imply RETAINED_MEM
    imply RETENTION
    imply RETENTION_BOOT_MODE
	select ZMK_BOARD_COMPAT
```

## config/west.yml
```yaml
manifest:
  defaults:
    revision: a23aa009d7a07d67fe5609caca7372e16610f238
  remotes:
    - name: zmkfirmware
      url-base: https://github.com/zmkfirmware
    # Additional modules containing boards/shields/custom code can be listed here as well
    # See https://docs.zephyrproject.org/3.2.0/develop/west/manifest.html#projects
    - name: elpekenin
      url-base: https://github.com/elpekenin
  projects:
    - name: zmk
      remote: zmkfirmware
      import: app/west.yml
    - name: zmk-userspace
      remote: elpekenin
      revision: main
  self:
    path: config
```
